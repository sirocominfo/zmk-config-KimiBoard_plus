## config/west.yml
```yaml
manifest:
  remotes:
    - name: zmkfirmware
      url-base: https://github.com/zmkfirmware
    - name: sirocominfo
      url-base: https://github.com/sirocominfo
    - name: caksorlar
      url-base: https://github.com/caksorlar
  projects:
    - name: zmk
      remote: zmkfirmware
      revision: main
      import: app/west.yml
    - name: zmk-pmw3610-driver
      remote: sirocominfo
      revision: main
    -name: zmk-rgbled-widget
      remote: caksorlar
      revision: main
  self:
    path: config
```
